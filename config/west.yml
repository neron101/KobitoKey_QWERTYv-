## config/west.yml
```yaml
manifest:
  remotes:
    - name: zmkfirmware
      url-base: https://github.com/zmkfirmware
    - name: cormoran
      url-base: https://github.com/cormoran
    - name: badjeff
      url-base: https://github.com/badjeff
    - name: hsgw
      url-base: https://github.com/hsgw
    - name: caksoylar
      url-base: https://github.com/caksoylar

  projects:
    # ZMK (cormoran fork with DYA Studio support)
    - name: zmk
      remote: cormoran
      revision: v0.3-branch+dya
      import: app/west.yml

    # PMW3610 trackball driver
    - name: zmk-pmw3610-driver
      remote: badjeff
      revision: zmk-0.3

    # Sensor-rotation input processor
    - name: zmk-feature-sensor_rotation
      remote: hsgw
      revision: main

    # LED widget
    - name: zmk-rgbled-widget
      remote: caksoylar
      revision: v0.3-branch

    # DYA Studio modules (pinned to ZMK v0.3 compatible revisions)
    - name: zmk-module-ble-management
      remote: cormoran
      revision: zmk-v0.3.0.0
    - name: zmk-module-battery-history
      remote: cormoran
      revision: main
    - name: zmk-module-settings-rpc
      remote: cormoran
      revision: main
    - name: zmk-module-runtime-input-processor
      remote: cormoran
      revision: zmk-v0.3.0.0

  self:
    path: config
```
